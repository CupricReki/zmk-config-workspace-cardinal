// Douple tap to bootloader
ZMK_BEHAVIOR(td_bootloader, tap_dance,
  tapping-term-ms = <200>;
  bindings = <XXX>, <&bootloader>;
)

 // Double tap to reset keyboard
ZMK_BEHAVIOR(td_reset, tap_dance,
  tapping-term-ms = <200>;
  bindings = <XXX>, <&sys_reset>;
)

// Double tap to clear all bluetooth
ZMK_BEHAVIOR(td_bt_clear_all, tap_dance,
  tapping-term-ms = <200>;
  bindings = <XXX>, <&bt BT_CLR_ALL>;
)

ZMK_BEHAVIOR(email_personal, macro,
  wait-ms = <0>;
  tap-ms = <5>;
  bindings = <&macro_press &kp LSHFT>, <&macro_tap &kp C>, <&macro_release &kp LSHFT>, <&macro_tap &kp U>, <&macro_tap &kp P> \
  , <&macro_tap &kp R>, <&macro_tap &kp I>, <&macro_tap &kp C>, <&macro_press &kp LSHFT>, <&macro_tap &kp R>, <&macro_release &kp LSHFT> \
  , <&macro_tap &kp E>, <&macro_tap &kp K>, <&macro_tap &kp I>, <&macro_tap &kp AT_SIGN>, <&macro_tap &kp G>, <&macro_tap &kp M> \
  , <&macro_tap &kp A>, <&macro_tap &kp I>, <&macro_tap &kp L>, <&macro_tap &kp DOT>, <&macro_tap &kp C>, <&macro_tap &kp O>, <&macro_tap &kp M>;
)


ZMK_BEHAVIOR(email_bMX, macro,
  wait-ms = <0>;
  tap-ms = <5>;
  bindings = <&macro_press &kp LSHFT>, <&macro_tap &kp S>, <&macro_release &kp LSHFT>, <&macro_tap &kp K>, <&macro_tap &kp Y> \
  , <&macro_tap &kp L>, <&macro_tap &kp E>, <&macro_tap &kp R>, <&macro_tap &kp DOT>, <&macro_press &kp LSHFT>, <&macro_tap &kp O> \
  , <&macro_release &kp LSHFT>, <&macro_tap &kp G>, <&macro_tap &kp D>, <&macro_tap &kp E>, <&macro_tap &kp N>, <&macro_tap &kp AT_SIGN> \
  , <&macro_tap &kp B>, <&macro_tap &kp I>, <&macro_tap &kp O>, <&macro_tap &kp M>, <&macro_tap &kp E>, <&macro_tap &kp R> \
  , <&macro_tap &kp I>, <&macro_tap &kp E>, <&macro_tap &kp U>, <&macro_tap &kp X>, <&macro_tap &kp DOT>, <&macro_tap &kp C> \
  , <&macro_tap &kp O>, <&macro_tap &kp M>;
)

// Double tap to clear all bluetooth
ZMK_BEHAVIOR(email, tap_dance,
  tapping-term-ms = <200>;
  bindings = <XXX>, <&email_personal>, <&email_bMX>;
)

/ {
  behaviors {
    change_tab: change_tab {
      compatible = "zmk,behavior-sensor-rotate";
      #sensor-binding-cells = <0>;
      bindings = <&kp LC(LS(TAB))>, <&kp LC(TAB)>;
    };
  };
};
